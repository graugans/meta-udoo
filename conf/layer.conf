## conf/layer.conf
```bitbake
# We have a conf and classes directory, add to BBPATH
BBPATH .= ":${LAYERDIR}"

# We have recipes-* directories, add to BBFILES
BBFILES += "${LAYERDIR}/recipes-*/*/*.bb \
         ${LAYERDIR}/recipes-*/*/*.bbappend"

BBFILE_COLLECTIONS += "meta-udoo"
BBFILE_PATTERN_meta-udoo = "^${LAYERDIR}/"
BBFILE_PRIORITY_meta-udoo = "10"
LAYERVERSION_meta-udoo = "3"

LAYERDEPENDS_meta-udoo = "core freescale-layer"

# Let us add layer-specific bbappends which are only applied when that
# layer is included in our configuration
BBFILES += "${@' '.join('${LAYERDIR}/%s/recipes*/*/*.bbappend' % layer \
               for layer in BBFILE_COLLECTIONS.split())}"
# Add layer-specific bb files too
BBFILES += "${@' '.join('${LAYERDIR}/%s/recipes*/*/*.bb' % layer \
               for layer in BBFILE_COLLECTIONS.split())}"
```

## conf/machine/include/udoo-imx-base.inc
```bitbake
# Vivante stuff
MACHINE_USES_VIVANTE_KERNEL_DRIVER_MODULE ?= "1"

# Das u-boot settings
UBOOT_MAKE_TARGET = ""
UBOOT_SUFFIX = "img"
UBOOT_CONFIG ??= "sd"
SPL_BINARY = "SPL"

# We use WIC for image creation
IMAGE_DEPENDS_wic_append = " virtual/bootloader"
WKS_FILE = "udoo-sdcard.wks" 
IMAGE_FSTYPES = "wic.bz2"

# There is no more boot partition so install the needed files to /boot
MACHINE_ESSENTIAL_EXTRA_RDEPENDS += " uenv kernel-devicetree \
"
```

## conf/machine/sbca62q1gb.conf
```bitbake
#@TYPE: Machine
#@NAME: A62
#@SOC: i.MX6Q
#@DESCRIPTION: Machine configuration for SECO A62 board

require conf/machine/include/imx-base.inc
require conf/machine/include/tune-cortexa9.inc

SOC_FAMILY = "mx6:mx6q"

UBOOT_CONFIG ??= "sd"
UBOOT_CONFIG[sd] = "mx6q_SBC_A62_config"
UBOOT_MAKE_TARGET = "DDR_SIZE=2 DDR_TYPE=1 BOARD_TYPE=A62 CPU_TYPE=QUAD ENV_DEVICE=ENV_MMC "

PREFERRED_PROVIDER_u-boot_mx6 = "u-boot-seco"
do_rootfs[depends] += "sbc-bootscript-sd:do_deploy"
BOOT_SCRIPTS = "bootscript"

PREFERRED_PROVIDER_virtual/kernel ?= "linux-seco"
PREFERRED_VERSION_linux-udooboard ?= "3.14%"


KERNEL_DEVICETREE = "imx6q-seco_SBC_A62.dtb"

SERIAL_CONSOLE = "115200 ttymxc1"

KERNEL_IMAGETYPE = "zImage"
PREFERRED_PROVIDER_virtual/mesa = ""
MACHINE_FEATURES += " wifi usbhost alsa"
MACHINE_EXTRA_RRECOMMENDS += " kernel-modules linux-firmware-ralink"
```

## conf/machine/secosbca62.conf
```bitbake
#@TYPE: Machine
#@NAME: A62
#@SOC: i.MX6Q
#@DESCRIPTION: Machine configuration for SECO A62 board

MACHINEOVERRIDES =. "mx6:mx6q:mx6dl:mx6s:"

require conf/machine/include/imx-base.inc
require conf/machine/include/tune-cortexa9.inc
include conf/machine/include/udoo-imx-base.inc

PREFERRED_PROVIDER_virtual/kernel ?= "linux-udooboard"
PREFERRED_VERSION_linux-udooboard ?= "3.14%"
PREFERRED_PROVIDER_virtual/mesa = ""


UBOOT_CONFIG[sd] = "udoo_a62_defconfig,sdcard"

KERNEL_DEVICETREE = " \
                     imx6dl-seco_A62-hdmi.dtb \
                     imx6dl-seco_A62-lvds7.dtb \
                     imx6dl-seco_A62-lvds15.dtb \
                     imx6dl-seco_A62-lvds7hdmi.dtb \
                     imx6dl-seco_A62.dtb \
                     imx6q-seco_A62.dtb \
                     imx6q-seco_A62-hdmi.dtb \
                     imx6q-seco_A62-lvds7.dtb \
                     imx6q-seco_A62-lvds15.dtb \
                     imx6q-seco_A62-lvds7hdmi.dtb \
"

SERIAL_CONSOLE = "115200 ttymxc1"

KERNEL_IMAGETYPE = "zImage"
MACHINE_FEATURES += " wifi usbhost alsa"
MACHINE_EXTRA_RRECOMMENDS += " kernel-modules linux-firmware-ralink"
```

## conf/machine/udooneo.conf
```bitbake
#@TYPE: Machine
#@NAME: UDOO Neo i.MX6 SoloX
#@SOC: i.MX6S
#@DESCRIPTION: Machine configuration for i.MX6 UDOO Neo SoloX
#@MAINTAINER: Christian Ege <ch@ege.io>

MACHINEOVERRIDES =. "mx6:mx6sx:"

include conf/machine/include/imx-base.inc
include conf/machine/include/tune-cortexa9.inc
include conf/machine/include/udoo-imx-base.inc

PREFERRED_PROVIDER_virtual/kernel ?= "linux-fmntf"
PREFERRED_VERSION_linux-udooboard ?= "4.1%"
KERNEL_IMAGETYPE = "zImage"

KERNEL_DEVICETREE ?= " \
    imx6sx-udoo-neo-basic-hdmi-m4.dtb \
    imx6sx-udoo-neo-basic-hdmi.dtb \
    imx6sx-udoo-neo-basic-lvds15.dtb \
    imx6sx-udoo-neo-basic-lvds15-m4.dtb \
    imx6sx-udoo-neo-basic-lvds7.dtb \
    imx6sx-udoo-neo-basic-lvds7-m4.dtb \
    imx6sx-udoo-neo-basic-m4.dtb \
    imx6sx-udoo-neo-basic.dtb \
    imx6sx-udoo-neo-basicks-hdmi-m4.dtb \
    imx6sx-udoo-neo-basicks-hdmi.dtb \
    imx6sx-udoo-neo-basicks-lvds15.dtb \
    imx6sx-udoo-neo-basicks-lvds15-m4.dtb \
    imx6sx-udoo-neo-basicks-lvds7.dtb \
    imx6sx-udoo-neo-basicks-lvds7-m4.dtb \
    imx6sx-udoo-neo-basicks-m4.dtb \
    imx6sx-udoo-neo-basicks.dtb \
    imx6sx-udoo-neo-extended-hdmi-m4.dtb \
    imx6sx-udoo-neo-extended-hdmi.dtb \
    imx6sx-udoo-neo-extended-lvds15.dtb \
    imx6sx-udoo-neo-extended-lvds15-m4.dtb \
    imx6sx-udoo-neo-extended-lvds7.dtb \
    imx6sx-udoo-neo-extended-lvds7-m4.dtb \
    imx6sx-udoo-neo-extended-m4.dtb \
    imx6sx-udoo-neo-extended.dtb \
    imx6sx-udoo-neo-full-hdmi-m4.dtb \
    imx6sx-udoo-neo-full-hdmi.dtb \
    imx6sx-udoo-neo-full-lvds15.dtb \
    imx6sx-udoo-neo-full-lvds15-m4.dtb \
    imx6sx-udoo-neo-full-lvds7.dtb \
    imx6sx-udoo-neo-full-lvds7-m4.dtb \
    imx6sx-udoo-neo-full-m4.dtb \
    imx6sx-udoo-neo-full.dtb \
"

UBOOT_CONFIG[sd] = "udoo_neo_config,sdcard"

MACHINE_FEATURES += " usbhost usbgadget bluetooth wifi"
MACHINE_EXTRA_RRECOMMENDS += " kernel-modules wl18xx-conf uim-sysfs bt-firmware udoofota"

SERIAL_CONSOLES ?= "115200;ttymxc0 115200;ttyGS0"
KERNEL_MODULE_AUTOLOAD += " g_serial"


# Select the video output mode
# Possible values are
# - hdmi (default)
# - lvds7
# - lvds15
VIDEO_OUTPUT ?= "hdmi"

# Select if the CAN-Bus shall be activated or not
ENABLE_CAN_BUS ?= "0"

# Select if the SPI bus on ESPI_2 shall be activated or not
ENABLE_SPI_BUS ?= "0"

# There is no more boot partition so install the needed files to /boot
MACHINE_ESSENTIAL_EXTRA_RDEPENDS += " udoo-u-boot-scr \
"
```

## conf/machine/udooqdl.conf
```bitbake
#@TYPE: Machine
#@NAME: UDOO Quad/Dual Board
#@SOC: i.MX6S
#@DESCRIPTION: Machine configuration for i.MX6 UDOO Quad/Dual board
#@MAINTAINER: Christian Ege <ch@ege.io>

MACHINEOVERRIDES =. "mx6:mx6dl:mx6q:"

include conf/machine/include/imx-base.inc
include conf/machine/include/tune-cortexa9.inc
include conf/machine/include/udoo-imx-base.inc


PREFERRED_PROVIDER_virtual/kernel ?= "linux-udooboard"
PREFERRED_VERSION_linux-udooboard ?= "3.14%"
KERNEL_IMAGETYPE = "zImage"

KERNEL_DEVICETREE ?= "imx6q-udoo-hdmi.dtb \
                      imx6q-udoo-lvds7.dtb \
                      imx6q-udoo-lvds15.dtb \
                      imx6dl-udoo-hdmi.dtb \
                      imx6dl-udoo-lvds7.dtb \
                      imx6dl-udoo-lvds15.dtb \
"

MACHINE_USES_VIVANTE_KERNEL_DRIVER_MODULE ?= "1"

UBOOT_CONFIG[sd] = "udoo_quad_dual_defconfig,sdcard"

MACHINE_FEATURES += " wifi usbhost alsa"

MACHINE_EXTRA_RRECOMMENDS += " kernel-modules linux-firmware-ralink bossac"

SERIAL_CONSOLES ?= "115200;ttymxc1"
```
